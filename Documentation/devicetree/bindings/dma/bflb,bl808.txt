## Documentation/devicetree/bindings/dma/bflb,bl808.txt
```
* Bouffalo Lab DMA controller

Required properties:
- compatible: Must be "bflb,bl808-dma".
- reg: Should contain DMA registers location and length.
- interrupts: Should contain all the interrupts required by all channels.
- #dma-cells: see dma.txt, should be 1.
- dma-channels: physical channels supported.
- dma-requests: virtual channels supported, each virtual channel
		have specific request line.
- clocks: clock required.

Example:

Controller:
		mm_dma: dma@30001000 {
			compatible = "bflb,bl808-dma";
			reg = <0x30001000 0x1000>;
			#dma-cells = <1>;
			dma-channels = <8>;
			dma-requests = <11>;
			interrupts = <40 IRQ_TYPE_LEVEL_HIGH>,
				   <41 IRQ_TYPE_LEVEL_HIGH>,
				   <42 IRQ_TYPE_LEVEL_HIGH>,
				   <43 IRQ_TYPE_LEVEL_HIGH>,
				   <44 IRQ_TYPE_LEVEL_HIGH>,
				   <45 IRQ_TYPE_LEVEL_HIGH>,
				   <46 IRQ_TYPE_LEVEL_HIGH>,
				   <47 IRQ_TYPE_LEVEL_HIGH>;
			clocks = <&xtal>;
			status = "okay";
			...
		};

Client:

Use specific request line.
For example,
	spi1: spi@30008000 {
		compatible = "bflb,bl808-spi";
		reg = <0x30008000 0x1000>;
		...
		dmas = <&mm_dma DMA_REQ_INFO(DMA_REQ_NONE, DMA_REQ_SPI1_TX)>,
		     <&mm_dma DMA_REQ_INFO(DMA_REQ_SPI1_RX, DMA_REQ_NONE)>;
		dma-names = "tx", "rx";
		...
		status = "okay";
	};
```

## Documentation/devicetree/bindings/pinctrl/pinctrl-bflb.txt
```
Bouffalo Lab pinctrl driver.

driver compatible name: bflb,bl808-pinctrl.

device tree properties:
bflb,pin-function: ref include/dt-bindings/pinctrl/pinctrl-bflb.h
bflb,pins: format <bank_idx pin_number config_phandle>,
	where bank_idx is always 0 at present,
	pin_number is the pin offset,
	config_phandle is a phandle to node with one or multiple standard or
	hardware specific configurations.

For example:
pinctrl: pinctrl@0 {
	compatible = "bflb,bl808-pinctrl";
	status = "okay";
	...

	pin_cfg_default: pin-cfg-default {
		bias-pull-pin-default;
		output-enable;
		input-enable;
	};

	mm_uart_pins: mm-uart-grp0 {
		bflb,pins = <0 16 &pin_cfg_default>,
					<0 17 &pin_cfg_default>;
		bflb,pin-function = <BFLB_PINMUX_FUNC_MM_UART>;
	};

	spi_foo_pins: mm-spi-grp0 {
		bflb,pins = <0 20 &pin_cfg_default>,
					<0 21 &pin_cfg_default>,
					<0 22 &pin_cfg_default>,
					<0 23 &pin_cfg_default>;
		bflb,pin-function = <BFLB_PINMUX_FUNC_MM_SPI>;
	};

	spi_bar_pins: mm-spi-grp1 {
		bflb,pins = <0 20 &pin_cfg_default>,
					<0 21 &pin_cfg_default>,
					<0 22 &pin_cfg_default>,
					<0 23 &pin_cfg_default>;
		bflb,pin-function = <BFLB_PINMUX_FUNC_MM_SPI>;
	};
};
```

## Documentation/devicetree/bindings/pwm/pwm-bflb.txt
```
Bouffalo Lab PWM controller

Required properties:
- compatible: should be "bflb,bl808-pwm"
- reg: physical base address and length of the controller's registers
- clocks: phandle to the input clock
- #pwm-cells: should be 3. See pwm.yaml in this directory for a description of
  the cells format.

Example:

pwm: pwm@2000a440 {
	compatible = "bflb,bl808-pwm";
	reg = <0x2000a440 0x40>;
	clocks = <&chip_clk CLKID_CFG>;
	#pwm-cells = <3>;
}
```

## Documentation/devicetree/bindings/spi/bflb-spi.txt
```
Bouffalo Lab SPI controller

This binding applies to the SPI controller.

Required properties:
- compatible: Should be "bflb,bl808-spi".
- reg: Should contain register location and length.
- interrupts: Should contain interrupt.
- clocks: The clock feeding the SPI controller.
- syscon: The phandle of global syscon node.

Optional:
- bflb,fifo-depth: TX/RX FIFO depth.
- bflb,max-bits-per-word: max bits per word.

Example:

spi1: spi@30008000 {
			compatible = "bflb,bl808-spi";
			reg = <0x30008000 0x1000>;
			interrupts-extended = <&plic 23 IRQ_TYPE_LEVEL_HIGH>;
			clocks = <&mm_muxpll_160m>;
			#address-cells = <1>;
			#size-cells = <0>;
			syscon = <&sys_ctrl>;
			bflb,fifo-depth = <32>;
			bflb,max-bits-per-word = <32>;
			status = "okay";
		};
```
